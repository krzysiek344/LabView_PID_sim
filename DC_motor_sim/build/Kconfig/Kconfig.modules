## DC_motor_sim/build/Kconfig/Kconfig.modules
```kconfig
config ZEPHYR_EMBEDDED_SYSTEM_MODULE
	bool
	default y
menu "cmsis_6 (/home/krzysztof/zephyrproject/modules/hal/cmsis_6)"
osource "$(ZEPHYR_CMSIS_6_KCONFIG)"
config ZEPHYR_CMSIS_6_MODULE
	bool
	default y
endmenu
config ZEPHYR_HAL_STM32_MODULE
	bool
	default y

config ZEPHYR_HAL_STM32_MODULE_BLOBS
	bool
```

## DC_motor_sim/build/Kconfig/Kconfig.shield
```kconfig
osource "/home/krzysztof/zephyrproject/embedded-system/boards/shields/*/Kconfig.shield"
```

## DC_motor_sim/build/Kconfig/boards/Kconfig.nucleo_f446re
```kconfig
# Load board Kconfig descriptions.
osource "/home/krzysztof/zephyrproject/zephyr/boards/st/nucleo_f446re/Kconfig.nucleo_f446re"
```

## build/Kconfig/arch/Kconfig
```kconfig
# Load Zephyr Arch Kconfig descriptions.
osource "/home/krzysztof/zephyrproject/zephyr/arch/rx/Kconfig"
osource "/home/krzysztof/zephyrproject/zephyr/arch/x86/Kconfig"
osource "/home/krzysztof/zephyrproject/zephyr/arch/xtensa/Kconfig"
osource "/home/krzysztof/zephyrproject/zephyr/arch/sparc/Kconfig"
osource "/home/krzysztof/zephyrproject/zephyr/arch/riscv/Kconfig"
osource "/home/krzysztof/zephyrproject/zephyr/arch/posix/Kconfig"
osource "/home/krzysztof/zephyrproject/zephyr/arch/mips/Kconfig"
osource "/home/krzysztof/zephyrproject/zephyr/arch/arm64/Kconfig"
osource "/home/krzysztof/zephyrproject/zephyr/arch/arm/Kconfig"
osource "/home/krzysztof/zephyrproject/zephyr/arch/arc/Kconfig"
```

## build/Kconfig/boards/Kconfig.defconfig
```kconfig
# Load Zephyr board defconfig descriptions.
osource "/home/krzysztof/zephyrproject/zephyr/boards/st/nucleo_f446re/Kconfig.defconfig"
```
